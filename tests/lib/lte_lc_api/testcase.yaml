## tests/lib/lte_lc_api/testcase.yaml
```yaml
tests:
  unity.lte_lc_api_test:
    sysbuild: true
    tags: lte_lc_api sysbuild
    platform_allow: native_sim
    integration_platforms:
      - native_sim
```

## tests/lib/modem_battery/testcase.yaml
```yaml
tests:
  modem_battery.unit_test:
    sysbuild: true
    tags: modem_battery sysbuild
    platform_allow: native_sim
    integration_platforms:
      - native_sim
```

## tests/lib/nrf_modem_lib/lte_net_if/testcase.yaml
```yaml
tests:
  nrf_modem_lib.lte_net_if:
    sysbuild: true
    tags: nrf_modem_lib sysbuild
    platform_allow: native_sim
    integration_platforms:
      - native_sim
```

## tests/lib/nrf_modem_lib/nrf91_sockets/testcase.yaml
```yaml
tests:
  unity.nrf91_sockets_test:
    sysbuild: true
    platform_allow: native_sim
    tags: nrf_modem_lib sysbuild
    integration_platforms:
      - native_sim
```

## tests/lib/pdn/testcase.yaml
```yaml
tests:
  pdn.unit_test:
    sysbuild: true
    tags: modem_info sysbuild
    platform_allow: native_sim
    integration_platforms:
      - native_sim
```

## tests/lib/qos/testcase.yaml
```yaml
tests:
  unity.qos:
    sysbuild: true
    platform_allow: qemu_cortex_m3 native_sim
    integration_platforms:
      - qemu_cortex_m3
      - native_sim
    tags: qos sysbuild
```

## tests/lib/sms/testcase.yaml
```yaml
tests:
  unity.sms_test:
    sysbuild: true
    tags: sms sysbuild
    platform_allow: native_sim
    integration_platforms:
      - native_sim
```

## tests/modules/lib/zcbor/decode/testcase.yaml
```yaml
tests:
  modules.lib.zcbor.decode:
    sysbuild: true
    tags: zcbor sysbuild
    platform_allow: native_sim
    integration_platforms:
      - native_sim
```

## tests/modules/lib/zcbor/raw_encode/testcase.yaml
```yaml
tests:
  modules.lib.zcbor.raw_encode:
    sysbuild: true
    tags: zcbor sysbuild
    platform_allow: native_sim
    integration_platforms:
      - native_sim
```

## tests/subsys/net/lib/aws_jobs/testcase.yaml
```yaml
tests:
  net.lib.aws_jobs:
    sysbuild: true
    platform_allow: native_sim qemu_cortex_m3
    integration_platforms:
      - native_sim
      - qemu_cortex_m3
    tags: aws sysbuild
```

## tests/subsys/sdfw_services/client/testcase.yaml
```yaml
tests:
  ssf.client:
    sysbuild: true
    platform_allow: native_sim
    integration_platforms:
      - native_sim
    tags: ssf sysbuild
```

## tests/subsys/sdfw_services/client_notif/testcase.yaml
```yaml
tests:
  ssf.client_notif:
    sysbuild: true
    platform_allow: native_sim
    integration_platforms:
      - native_sim
    tags: ssf sysbuild
```

## tests/subsys/suit/digest_sink/testcase.yaml
```yaml
tests:
  suit.integration.digest_sink:
    platform_allow: nrf52840dk/nrf52840 native_sim
    tags: suit suit_digest_sink ci_tests_subsys_suit
    timeout: 240
    integration_platforms:
      - nrf52840dk/nrf52840
      - native_sim
```

## tests/subsys/suit/envelope_decoder/testcase.yaml
```yaml
tests:
  suit-processor.integration.envelope_decoder:
    platform_allow: native_sim
    build_only: true
    tags: suit-processor envelope-decoder suit ci_tests_subsys_suit
```

## tests/subsys/suit/invoke/testcase.yaml
```yaml
tests:
  suit-platform.integration.invoke:
    platform_allow: native_sim
    tags: suit-processor suit_platform suit ci_tests_subsys_suit
    integration_platforms:
      - native_sim
```

## tests/subsys/suit/mci/testcase.yaml
```yaml
tests:
  suit-processor.integration.suit_mci:
    platform_allow: native_sim
    tags: suit-mci suit ci_tests_subsys_suit
    integration_platforms:
      - native_sim
```

## tests/subsys/suit/orchestrator/orchestrator_sdfw/testcase.yaml
```yaml
tests:
  suit.integration.orchestrator:
    platform_allow: nrf52840dk/nrf52840 native_sim
    tags: suit suit_orchestrator ci_tests_subsys_suit
    timeout: 240
    integration_platforms:
      - nrf52840dk/nrf52840
      - native_sim
```

## tests/subsys/suit/sink_selector/testcase.yaml
```yaml
tests:
  suit-platform.integration.sink_selector:
    platform_allow: native_sim
    tags: suit-processor suit_platform suit ci_tests_subsys_suit
    integration_platforms:
      - native_sim
```

## tests/subsys/suit/suit_memptr_storage/testcase.yaml
```yaml
tests:
  suit-platform.integration.common.memptr_storage:
    platform_allow: nrf52840dk/nrf52840 native_sim
    tags: suit-processor suit_platform suit_memptr_storage suit ci_tests_subsys_suit
    integration_platforms:
      - nrf52840dk/nrf52840
      - native_sim
```

## tests/unity/example_test/testcase.yaml
```yaml
tests:
  unity.example_test:
    sysbuild: true
    tags: example sysbuild
    integration_platforms:
      - native_sim
    platform_allow:
      - native_sim
```

## tests/unity/wrap_test/testcase.yaml
```yaml
tests:
  unity.wrap_test:
    sysbuild: true
    tags: wrap_test sysbuild
    platform_allow:
      - native_sim
    integration_platforms:
      - native_sim
```
